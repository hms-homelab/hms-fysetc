## main/Kconfig.projbuild
```kconfig
menu "HMS-FYSETC Configuration"

    menu "WiFi Configuration"
        config FYSETC_WIFI_SSID
            string "WiFi SSID"
            default "your_wifi_ssid"
            help
                WiFi network name to connect to.

        config FYSETC_WIFI_PASSWORD
            string "WiFi Password"
            default "your_wifi_password"
            help
                WiFi network password.

        config FYSETC_WIFI_MAX_RETRY
            int "WiFi max connection retries"
            default 10
            help
                Maximum number of WiFi connection retries before giving up.
    endmenu

    menu "SD Bus"
        config FYSETC_PCNT_SAMPLE_MS
            int "PCNT sample interval (ms)"
            default 100
            help
                Sample the PCNT counter every N milliseconds to monitor
                host activity on the SD bus.

        config FYSETC_PCNT_GLITCH_FILTER
            int "PCNT glitch filter threshold"
            default 10
            help
                Ignore pulses shorter than ~100ns (filter value 10).
    endmenu

    menu "Device Identity"
        config FYSETC_DEVICE_NAME
            string "Device name"
            default "hms-fysetc"
            help
                Human-readable device name. Also used in captive portal
                AP SSID (last 4 chars appended to FYSETC-Setup-).

        config FYSETC_LOG_TAG
            string "Log tag"
            default "FYSETC"
            help
                ESP_LOG tag prefix for all log messages.
    endmenu

endmenu
```

## sdkconfig.defaults
```kconfig
# Target: ESP32 (PICO-D4 on FYSETC SD WiFi Pro)
CONFIG_IDF_TARGET="esp32"

# Flash (4MB internal on ESP32-PICO-D4)
CONFIG_ESPTOOLPY_FLASHSIZE_4MB=y
CONFIG_PARTITION_TABLE_CUSTOM=y
CONFIG_PARTITION_TABLE_CUSTOM_FILENAME="partitions.csv"

# PSRAM disabled (not all FYSETC boards have PSRAM populated)
# CONFIG_ESP32_SPIRAM_SUPPORT is not set

# FreeRTOS
CONFIG_FREERTOS_HZ=1000
CONFIG_ESP_TASK_WDT_TIMEOUT_S=30

# SDMMC (4-bit SDIO mode for onboard NAND)
CONFIG_SOC_SDMMC_HOST_SUPPORTED=y

# HTTP client
CONFIG_ESP_HTTP_CLIENT_ENABLE_HTTPS=n

# Logging
CONFIG_LOG_DEFAULT_LEVEL_INFO=y
CONFIG_LOG_MAXIMUM_LEVEL_DEBUG=y

# Stack sizes
CONFIG_ESP_MAIN_TASK_STACK_SIZE=8192
CONFIG_PTHREAD_TASK_STACK_SIZE_DEFAULT=4096
```
